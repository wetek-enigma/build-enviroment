## meta-legacy/conf/layer.conf
```bitbake
# We have a recipes directory, add to BBFILES
BBFILES += "${LAYERDIR}/recipes-*/*/*.bb ${LAYERDIR}/recipes-*/*/*.bbappend"

BBFILE_COLLECTIONS += "legacy-layer"
BBFILE_PATTERN_legacy-layer := "^${LAYERDIR}/"
BBFILE_PRIORITY_legacy-layer = "99"
```
